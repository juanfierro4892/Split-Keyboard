## config/boards/shields/Keyboard/Kconfig.defconfig
```kconfig
if SHIELD_KEYBOARD_LEFT || SHIELD_KEYBOARD_RIGHT

config ZMK_KEYBOARD_NAME
    default "Keyboard"

endif
```

## config/boards/shields/Keyboard/Kconfig.shield
```kconfig
config SHIELD_KEYBOARD_LEFT
    def_bool $(shields_list_contains,Keyboard_left)

config SHIELD_KEYBOARD_RIGHT
    def_bool $(shields_list_contains,Keyboard_right)
```
