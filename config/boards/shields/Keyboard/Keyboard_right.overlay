#include <dt-bindings/zmk/matrix_transform.h>

/ {
    chosen {
        zmk,kscan = &kscan0;
    };

    kscan0: kscan_0 {
        compatible = "zmk,kscan-gpio-matrix";
        diode-direction = "col2row";
        
        col-offset = <5>; 

        row-gpios
            = <&xiao_d 10 (GPIO_ACTIVE_HIGH | GPIO_PULL_DOWN)> // ROW0
            , <&xiao_d  9 (GPIO_ACTIVE_HIGH | GPIO_PULL_DOWN)> // ROW1
            , <&xiao_d  8 (GPIO_ACTIVE_HIGH | GPIO_PULL_DOWN)> // ROW2
            , <&xiao_d  7 (GPIO_ACTIVE_HIGH | GPIO_PULL_DOWN)> // ROW3
            , <&xiao_d  6 (GPIO_ACTIVE_HIGH | GPIO_PULL_DOWN)> // ROW4
            ;

        col-gpios
            = <&xiao_d  0 GPIO_ACTIVE_HIGH> // COL0
            , <&xiao_d  1 GPIO_ACTIVE_HIGH> // COL1
            , <&xiao_d  2 GPIO_ACTIVE_HIGH> // COL2
            , <&xiao_d  3 GPIO_ACTIVE_HIGH> // COL3
            , <&xiao_d  4 GPIO_ACTIVE_HIGH> // COL4
            ;
    };
};